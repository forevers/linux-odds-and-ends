// ess moc configuration
/dts-v1/;
/plugin/;

/ {
    compatible = "brcm,bcm2711";

    fragment@0 {
        target = <&soc>;
        __overlay__ {
            ess-dma-moc {
                compatible = "ess,ess-dma-moc";
                buffer_size = <12345>;
                status = "okay";
            };
        };
    };

};
